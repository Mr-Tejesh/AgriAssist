//#############################~~~~CLOUD INITIALIZATION BEGIN~~~~#############################

#include "ThingSpeak.h"
#include<DHTesp.h>
#include<WiFi.h>

//Network Credentials
const char* ssid = "Tejesh G8X"; //Enter SSID
const char* password = "jest5678"; //Enter password


//—–ThingSpeak channel details
unsigned long myChannelNumber = 3;
const char * myWriteAPIKey = "CW8BYM8OPSGN55AE";

WiFiClient client;

//—– Timer variables
unsigned long lastTime = 0;
unsigned long timerDelay = 30000;  //10 seconds

//#############################~~~~CLOUD INITIALIZATION END~~~~#############################


//#############################~~~~NOKIA DISPLAY INITIALIZATION BEGIN~~~~#############################

#include <SPI.h>
#include <Adafruit_GFX.h>
#include <Adafruit_PCD8544.h>

/* Declare LCD object for SPI
 Adafruit_PCD8544(CLK,DIN,D/C,CE,RST); */
Adafruit_PCD8544 display = Adafruit_PCD8544(18, 23, 4, 15, 2);
int contrastValue = 0; // Default Contrast Value
const int adcPin = 34;
int adcValue = 0;
int dispStart=0;

const unsigned char frame8 [] PROGMEM = {
  0xff, 0xff, 0xff, 0xff, 0xff, 0xff, 0xff, 0xff, 0xff, 0xff, 0xf0, 0xff, 0xff, 0xff, 0xff, 0xff, 
  0xff, 0xff, 0xff, 0xff, 0xff, 0xf0, 0xff, 0xff, 0xff, 0xff, 0xff, 0xff, 0xff, 0xff, 0xff, 0xff, 
  0xf0, 0xff, 0xff, 0xff, 0xff, 0xff, 0xff, 0x1f, 0xff, 0xff, 0xff, 0xf0, 0xff, 0xff, 0xff, 0xff, 
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  0xff, 0xff, 0xff, 0xff, 0xff, 0xff, 0xff, 0xff, 0xff, 0xff, 0xf0
};

const unsigned char frame0 [] PROGMEM = {
  0x00, 0x00, 0x00, 0x00, 0x18, 0x00, 0x00, 0x3c, 0x00, 0x02, 0x7e, 0x00, 0x0f, 0x7e, 0x00, 0x0f, 
  0xbc, 0x00, 0x1f, 0x98, 0x00, 0x0f, 0x80, 0x00, 0x07, 0x00, 0x00, 0x10, 0x00, 0x00, 0x3c, 0x00, 
  0x00, 0x7e, 0x00, 0x00, 0x7e, 0x00, 0x00, 0x3c, 0x00, 0x00, 0x18, 0x00, 0x00, 0x00, 0x00, 0x00, 
  0x00, 0x00, 0x00, 0x00, 0x00, 0x00, 0x00, 0x00, 0x00, 0x00, 0x00, 0x00, 0x00, 0x00, 0x00, 0x00, 
  0x00, 0x00, 0x00, 0x00, 0x00, 0x00, 0x00, 0x00
};

const unsigned char frame1 [] PROGMEM = {
  0x00, 0x00, 0x00, 0x00, 0x18, 0x00, 0x00, 0x3c, 0x00, 0x00, 0x7e, 0x40, 0x0f, 0x7e, 0xf0, 0x0f, 
  0xbd, 0xf0, 0x0f, 0x99, 0xf0, 0x0f, 0x81, 0xf0, 0x07, 0x00, 0xe0, 0x00, 0x00, 0x00, 0x00, 0x00, 
  0x00, 0x00, 0x00, 0x00, 0x00, 0x00, 0x00, 0x00, 0x00, 0x00, 0x00, 0x00, 0x00, 0x00, 0x00, 0x00, 
  0x00, 0x00, 0x00, 0x00, 0x00, 0x00, 0x00, 0x00, 0x00, 0x00, 0x00, 0x00, 0x00, 0x00, 0x00, 0x00, 
  0x00, 0x00, 0x00, 0x00, 0x00, 0x00, 0x00, 0x00
};

const unsigned char frame2 [] PROGMEM = {
  0x00, 0x00, 0x00, 0x00, 0x18, 0x00, 0x00, 0x3c, 0x00, 0x00, 0x7e, 0x60, 0x00, 0x3e, 0xf0, 0x00, 
  0x3d, 0xf8, 0x00, 0x19, 0xf8, 0x00, 0x01, 0xf0, 0x00, 0x00, 0xe0, 0x00, 0x00, 0x3c, 0x00, 0x00, 
  0x3e, 0x00, 0x00, 0x7e, 0x00, 0x00, 0x7e, 0x00, 0x00, 0x3c, 0x00, 0x00, 0x18, 0x00, 0x00, 0x00, 
  0x00, 0x00, 0x00, 0x00, 0x00, 0x00, 0x00, 0x00, 0x00, 0x00, 0x00, 0x00, 0x00, 0x00, 0x00, 0x00, 
  0x00, 0x00, 0x00, 0x00, 0x00, 0x00, 0x00, 0x00
};

const unsigned char frame3 [] PROGMEM = {
  0x00, 0x00, 0x00, 0x00, 0x00, 0x00, 0x00, 0x00, 0x00, 0x00, 0x00, 0x00, 0x00, 0x00, 0xf0, 0x00, 
  0x01, 0xf0, 0x00, 0x01, 0xf0, 0x00, 0x01, 0xf0, 0x00, 0x00, 0xe0, 0x00, 0x00, 0x1c, 0x00, 0x00, 
  0x3e, 0x00, 0x00, 0x7e, 0x00, 0x00, 0x7e, 0x00, 0x00, 0x3c, 0x00, 0x00, 0x18, 0x00, 0x00, 0xf0, 
  0x00, 0x01, 0xf0, 0x00, 0x01, 0xf8, 0x00, 0x01, 0xf0, 0x00, 0x00, 0xf0, 0x00, 0x00, 0x00, 0x00, 
  0x00, 0x00, 0x00, 0x00, 0x00, 0x00, 0x00, 0x00
};

const unsigned char frame4 [] PROGMEM = {
  0x00, 0x00, 0x00, 0x00, 0x00, 0x00, 0x00, 0x00, 0x00, 0x00, 0x00, 0x00, 0x00, 0x00, 0x00, 0x00, 
  0x00, 0x00, 0x00, 0x00, 0x00, 0x00, 0x00, 0x00, 0x00, 0x00, 0x00, 0x00, 0x00, 0x18, 0x00, 0x00, 
  0x3c, 0x00, 0x00, 0x7e, 0x00, 0x00, 0x3e, 0x00, 0x00, 0x3c, 0x00, 0x00, 0x00, 0x00, 0x00, 0xf0, 
  0x00, 0x01, 0xf0, 0x00, 0x1d, 0xf8, 0x00, 0x3f, 0xf0, 0x00, 0x7e, 0xf0, 0x00, 0x7e, 0x00, 0x00, 
  0x3c, 0x00, 0x00, 0x18, 0x00, 0x00, 0x00, 0x00
};

const unsigned char frame5 [] PROGMEM = {
  0x00, 0x00, 0x00, 0x00, 0x00, 0x00, 0x00, 0x00, 0x00, 0x00, 0x00, 0x00, 0x00, 0x00, 0x00, 0x00, 
  0x00, 0x00, 0x00, 0x00, 0x00, 0x00, 0x00, 0x00, 0x00, 0x00, 0x00, 0x00, 0x00, 0x00, 0x00, 0x00, 
  0x00, 0x00, 0x00, 0x00, 0x00, 0x00, 0x00, 0x00, 0x00, 0x00, 0x00, 0x00, 0x00, 0x0f, 0x00, 0xe0, 
  0x0f, 0x81, 0xf0, 0x0f, 0x99, 0xf0, 0x0f, 0xbf, 0xf0, 0x0f, 0x7e, 0xe0, 0x00, 0x7e, 0x00, 0x00, 
  0x3c, 0x00, 0x00, 0x18, 0x00, 0x00, 0x00, 0x00
};

const unsigned char frame6 [] PROGMEM = {
  0x00, 0x00, 0x00, 0x00, 0x00, 0x00, 0x00, 0x00, 0x00, 0x00, 0x00, 0x00, 0x00, 0x00, 0x00, 0x00, 
  0x00, 0x00, 0x00, 0x00, 0x00, 0x00, 0x00, 0x00, 0x00, 0x00, 0x00, 0x1c, 0x00, 0x00, 0x3e, 0x00, 
  0x00, 0x7e, 0x00, 0x00, 0x7e, 0x00, 0x00, 0x3c, 0x00, 0x00, 0x18, 0x00, 0x00, 0x07, 0x00, 0x00, 
  0x0f, 0x80, 0x00, 0x0f, 0x98, 0x00, 0x0f, 0xbc, 0x00, 0x0f, 0x3e, 0x00, 0x00, 0x3e, 0x00, 0x00, 
  0x3c, 0x00, 0x00, 0x00, 0x00, 0x00, 0x00, 0x00
};

const unsigned char frame7 [] PROGMEM = {
  0x00, 0x00, 0x00, 0x00, 0x00, 0x00, 0x00, 0x00, 0x00, 0x06, 0x00, 0x00, 0x0f, 0x80, 0x00, 0x0f, 
  0x80, 0x00, 0x0f, 0x80, 0x00, 0x0f, 0x80, 0x00, 0x07, 0x00, 0x00, 0x38, 0x00, 0x00, 0x7c, 0x00, 
  0x00, 0x7e, 0x00, 0x00, 0x7e, 0x00, 0x00, 0x3c, 0x00, 0x00, 0x18, 0x00, 0x00, 0x07, 0x00, 0x00, 
  0x0f, 0x80, 0x00, 0x0f, 0x80, 0x00, 0x0f, 0x80, 0x00, 0x07, 0x00, 0x00, 0x00, 0x00, 0x00, 0x00, 
  0x00, 0x00, 0x00, 0x00, 0x00, 0x00, 0x00, 0x00
};

//#############################~~~~NOKIA DISPLAY INITIALIZATION END~~~~#############################


//#############################~~~~SENSORS INITIALIZATION BEGIN~~~~#############################

#include "DHT.h"        //Includes dht library for ESP boards

#define DHTTYPE DHT11
#define DHT11PIN 25       //Digital pin of DHT11-temperature sensor
int soil_pin = 35;       //Analog pin of soil sensr 
int rain_pin = 14;       //Digital pin of rain sensor
int soilval, is_raining, soilm, soil_moisture, rainsens;  
int waterp = 22  ;//Random variables for different sensors
float humid, tempi, temperatre, humidity;
DHT dht(DHT11PIN, DHTTYPE);

float temp();
int soil();
int rain();
float hum();
int water(int soilm);
void thsensdisp(float t, float h);
void srsensdisp(int s, int r);
//#############################~~~~SENSORS INITIALIZATION END~~~~#############################

void setup() {

//#############################~~~~CLOUD SETUP BEGIN~~~~#############################

  Serial.begin(115200);
  Serial.println("LOADING.......");
  WiFi.mode(WIFI_STA);
  ThingSpeak.begin(client);

//#############################~~~~CLOUD SETUP END~~~~#############################


//#############################~~~~SENSORS SETUP BEGIN~~~~#############################

  dht.begin();
  pinMode(waterp, OUTPUT);
  Serial.println("LOADING.......");
  delay(5000);

//#############################~~~~SENSORS SETUP END~~~~#############################

}

void loop() {

//#############################~~~~CLOUD LOOP BEGIN~~~~#############################

  if ((millis() - lastTime) > timerDelay) {
    
    // Connect or reconnect to WiFi
    if(WiFi.status() != WL_CONNECTED){
      Serial.print("Attempting to connect");
      while(WiFi.status() != WL_CONNECTED){
        WiFi.begin(ssid, password); 
        delay(5000);     
      } 
      Serial.println("\nConnected.");
    }
  }
//#############################~~~~CLOUD LOOP END~~~~#############################

//  #############################~~~~SENSORS LOOP BEGIN~~~~#############################
  
  if(dispStart<1){
    displaym(); 
    delay(2000);
  }
  else if(dispStart==1){ 
displayn8();
    delay(2222);
    displayn0();
    delay(200);
    displayn1();
    delay(300);
    displayn2();
    delay(300);
    displayn3();
    delay(300);
    displayn4();
    delay(300);
    displayn5();
    delay(300);
    displayn6();
    delay(300);
    displayn7();
    delay(300);
    displayn0();
    delay(300);
    displayn1();
    delay(300);
    displayn2();
    delay(300);
    displayn3();
    delay(300);
    displayn4();
    delay(300);
    displayn5();
    delay(300);
    displayn6();
    delay(300);
    displayn7();
    delay(300);  }
  else if(dispStart%2==0){
    temperatre = temp();
    humidity = hum();
    soil_moisture = soil();
    rainsens = rain();
    thsensdisp(temperatre, humidity);
    delay(3500);


    Serial.println("");
    Serial.println("");
    Serial.println(""); 

//    Serial.println(rainsens);
//    Serial.println(temperatre);
//    Serial.println(soil_moisture);
//    Serial.println(humidity);

    delay(3500);

  }
  else{
    temperatre = temp();
    humidity = hum();
    soil_moisture = soil();
    rainsens = rain();
    water(soil_moisture);
    srsensdisp(soil_moisture, rainsens);

    Serial.println("");
    Serial.println("");
    Serial.println("");
    
//    Serial.println(rainsens);
//    Serial.println(temperatre);
//    Serial.println(soil_moisture);
//    Serial.println(humidity);

    delay(3500);
  }
  dispStart = dispStart+1;
  ThingSpeak.setField(1,temperatre);  
  ThingSpeak.setField(2,humidity);  
  ThingSpeak.setField(3,soil_moisture);  
  ThingSpeak.setField(4,rainsens);  

  int x =ThingSpeak.writeFields(myChannelNumber, myWriteAPIKey);
  if(x==200){
    Serial.println("Channel update successfully");
  }
  else{
    Serial.println("Problem updating channel.HTTP error code: "+String(x));
  }
  
//#############################~~~~SENSORS LOOP END~~~~#############################

}

//#############################~~~~SENSORS FUNCTIONS BEGIN~~~~#############################

int rain(){                                    //Function to get values from rain sensor
  int is_raining = digitalRead(rain_pin);
  if(is_raining == 0){
    Serial.println("Raining");
  }
  else{
    Serial.println("Not raining");
  }
  
//  ThingSpeak.setField(4,is_raining);
//  Serial.println("");
  return is_raining;
  
}

int soil(){                                    //Function to get values from soil sensor
    Serial.print("Analog output: ");

    int soilval = analogRead(soil_pin);  // Read the analog value form sensor
    Serial.println(soilval/4);
//    ThingSpeak.setField(3,soilval);
//    Serial.println("");
    return soilval;
}

float temp(){
  float tempi = dht.readTemperature();
  Serial.print("Temperature: ");
  Serial.print(tempi);
  Serial.println("ºC ");
  delay(1000);
//  ThingSpeak.setField(1,tempi);  
  return tempi;
}

float hum(){
  float humi = dht.readHumidity();
  Serial.print("Humidity: ");
  Serial.println(humi);
  delay(1000);
//  ThingSpeak.setField(2,humi);
  return humi;
}

int water(int soilm){
  if(soilm>2600){
    digitalWrite(waterp, HIGH);
    Serial.println("Pump ON");
  }if(soilm<2600){
    digitalWrite(waterp, LOW);
    Serial.println("Pump OFF");
  }
  delay(500);
  return 0;
}

//#############################~~~~SENSORS FUNCTIONS ENDS~~~~#############################

//#############################~~~~DISPLAY FUNCTIONS BEGINS~~~~#############################

void displaym(){
  display.begin();

  /* Change the contrast using the following API*/
  display.setContrast(70);

  /* Clear the buffer */
  display.clearDisplay();
  display.display();
  delay(1000);
  
  /* Now let us display some text */
  display.setTextColor(BLACK, WHITE);
  display.setCursor(0,1);
  display.setTextSize(2);
  display.println("WELCOME");
  display.setTextSize(1);
  display.setTextColor(BLACK);
  display.setCursor(16,20);
  display.println("|PROJECT|");
  display.setCursor(22,32);
  display.println("|DPTV6|");
  display.display();
  delay(2000);

}

void displayn8(){
  display.begin();

  // you can change the contrast around to adapt the display for the best viewing!
  display.setContrast(70);

  // Clear the buffer.
  display.clearDisplay();
 
  // Display bitmap
  
  display.drawBitmap(0, 0,  frame8, 84, 48, BLACK);
  display.display();
//  delay(200);

}

void displayn0(){
  display.begin();

  // you can change the contrast around to adapt the display for the best viewing!
  display.setContrast(47);

  // Clear the buffer.
  display.clearDisplay();
   display.setCursor(10,10);
  display.setTextSize(1);
  display.print("Loading.");
  // Display bitmap
  
  display.drawBitmap(24, 24,  frame0, 24, 24, BLACK);
  display.display();
//  delay(200);

}

void displayn1(){
  display.begin();

  // you can change the contrast around to adapt the display for the best viewing!
  display.setContrast(70);

  // Clear the buffer.
  display.clearDisplay();
   display.setCursor(10,10);
  display.setTextSize(1);
  display.print("Loading..");
  // Display bitmap
  
  display.drawBitmap(24, 24,  frame1, 24, 24, BLACK);
  display.display();
//  delay(200);

}

void displayn2(){
  display.begin();

  // you can change the contrast around to adapt the display for the best viewing!
  display.setContrast(70);

  // Clear the buffer.
  display.clearDisplay();
   display.setCursor(10,10);
  display.setTextSize(1);
  display.print("Loading...");
  // Display bitmap
  
  display.drawBitmap(24, 24,  frame2, 24, 24, BLACK);
  display.display();
//  delay(200);

}

void displayn3(){
  display.begin();

  // you can change the contrast around to adapt the display for the best viewing!
  display.setContrast(70);

  // Clear the buffer.
  display.clearDisplay();
   display.setCursor(10,10);
  display.setTextSize(1);
  display.print("Loading....");
  // Display bitmap
  
  display.drawBitmap(24, 24,  frame3, 24, 24, BLACK);
  display.display();
//  delay(200);

}

void displayn4(){
  display.begin();

  // you can change the contrast around to adapt the display for the best viewing!
  display.setContrast(70);

  // Clear the buffer.
  display.clearDisplay();
   display.setCursor(10,10);
  display.setTextSize(1);
  display.print("Loading.");
  // Display bitmap
  
  display.drawBitmap(24, 24,  frame4, 24, 24, BLACK);
  display.display();
//  delay(200);

}

void displayn5(){
  display.begin();

  // you can change the contrast around to adapt the display for the best viewing!
  display.setContrast(70);

  // Clear the buffer.
  display.clearDisplay();
   display.setCursor(10,10);
  display.setTextSize(1);
  display.print("Loading..");
  // Display bitmap
  
  display.drawBitmap(24, 24,  frame5, 24, 24, BLACK);
  display.display();
//  delay(200);

}

void displayn6(){
  display.begin();

  // you can change the contrast around to adapt the display for the best viewing!
  display.setContrast(70);

  // Clear the buffer.
  display.clearDisplay();
   display.setCursor(10,10);
  display.setTextSize(1);
  display.print("Loading...");
  // Display bitmap
  
  display.drawBitmap(24, 24,  frame6, 24, 24, BLACK);
  display.display();
//  delay(200);

}

void displayn7(){
  display.begin();

  // you can change the contrast around to adapt the display for the best viewing!
  display.setContrast(70);

  // Clear the buffer.
  display.clearDisplay();
   display.setCursor(10,10);
  display.setTextSize(1);
  display.print("Loading....");
  // Display bitmap
  
  display.drawBitmap(24, 24,  frame7, 24, 24, BLACK);
  display.display();
//  delay(200);

}


void thsensdisp(float t, float h){
  display.begin();
  display.setContrast(70);
  display.clearDisplay();
  display.setCursor(10,10);
  display.setTextSize(1);
  display.print("Temperature");
  display.setCursor(26,20);
  display.print(t);
  display.setCursor(18,30);
  display.setTextSize(1);
  display.print("Humidity");
  display.setCursor(26,40);
  display.print(h);
  delay(3500);
}

void srsensdisp(int s, int r){

  display.begin();
  display.setContrast(70  );
  display.clearDisplay();
  display.setCursor(14,10);
  display.setTextSize(1);
  display.print("Soil: ");
  display.print(s/4);
  display.setCursor(20,20);
  if(s>2600){
    display.print("Pump ON");
  }if(s<2600){
    display.print("Pump OFF");
  }
 
  display.setCursor(20,30);
  display.setTextSize(1);
  display.print("Rain: ");
  display.print(r);
  display.setCursor(10,40); 
  if(r == 0){
    display.print("Raining");
  }
  else{
    display.print("Not raining");
  }
  delay(3500);
}
//#############################~~~~DISPLAY FUNCTIONS ENDS~~~~#############################
